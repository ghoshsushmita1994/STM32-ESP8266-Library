// ===========================================================================
// Copyright (c) 2018, Electric Power Research Institute (EPRI)
// All rights reserved.
//
// DLMS-COSEM ("this software") is licensed under BSD 3-Clause license.
//
// Redistribution and use in source and binary forms, with or without modification,
// are permitted provided that the following conditions are met:
//
// *  Redistributions of source code must retain the above copyright notice, this
//    list of conditions and the following disclaimer.
//
// *  Redistributions in binary form must reproduce the above copyright notice,
//    this list of conditions and the following disclaimer in the documentation
//    and/or other materials provided with the distribution.
//
// *  Neither the name of EPRI nor the names of its contributors may
//    be used to endorse or promote products derived from this software without
//    specific prior written permission.
//
// THIS SOFTWARE IS PROVIDED BY THE COPYRIGHT HOLDERS AND CONTRIBUTORS "AS IS" AND
// ANY EXPRESS OR IMPLIED WARRANTIES, INCLUDING, BUT NOT LIMITED TO, THE IMPLIED
// WARRANTIES OF MERCHANTABILITY AND FITNESS FOR A PARTICULAR PURPOSE ARE DISCLAIMED.
// IN NO EVENT SHALL THE COPYRIGHT HOLDER OR CONTRIBUTORS BE LIABLE FOR ANY DIRECT,
// INDIRECT, INCIDENTAL, SPECIAL, EXEMPLARY, OR CONSEQUENTIAL DAMAGES (INCLUDING, BUT
// NOT LIMITED TO, PROCUREMENT OF SUBSTITUTE GOODS OR SERVICES; LOSS OF USE, DATA, OR
// PROFITS; OR BUSINESS INTERRUPTION) HOWEVER CAUSED AND ON ANY THEORY OF LIABILITY,
// WHETHER IN CONTRACT, STRICT LIABILITY, OR TORT (INCLUDING NEGLIGENCE OR OTHERWISE)
// ARISING IN ANY WAY OUT OF THE USE OF THIS SOFTWARE, EVEN IF ADVISED OF THE POSSIBILITY
// OF SUCH DAMAGE.
//
// This EPRI software incorporates work covered by the following copyright and permission
// notices. You may not use these works except in compliance with their respective
// licenses, which are provided below.
//
// These works are provided by the copyright holders and contributors "as is" and any express or
// implied warranties, including, but not limited to, the implied warranties of merchantability
// and fitness for a particular purpose are disclaimed.
//
// This software relies on the following libraries and licenses:
//
// ###########################################################################
// Boost Software License, Version 1.0
// ###########################################################################
//
// * asio v1.10.8 (https://sourceforge.net/projects/asio/files/)
//
// Boost Software License - Version 1.0 - August 17th, 2003
//
// Permission is hereby granted, free of charge, to any person or organization
// obtaining a copy of the software and accompanying documentation covered by
// this license (the "Software") to use, reproduce, display, distribute,
// execute, and transmit the Software, and to prepare derivative works of the
// Software, and to permit third-parties to whom the Software is furnished to
// do so, all subject to the following:
//
// The copyright notices in the Software and this entire statement, including
// the above license grant, this restriction and the following disclaimer,
// must be included in all copies of the Software, in whole or in part, and
// all derivative works of the Software, unless such copies or derivative
// works are solely in the form of machine-executable object code generated by
// a source language processor.
//
// THE SOFTWARE IS PROVIDED "AS IS", WITHOUT WARRANTY OF ANY KIND, EXPRESS OR
// IMPLIED, INCLUDING BUT NOT LIMITED TO THE WARRANTIES OF MERCHANTABILITY,
// FITNESS FOR A PARTICULAR PURPOSE, TITLE AND NON-INFRINGEMENT. IN NO EVENT
// SHALL THE COPYRIGHT HOLDERS OR ANYONE DISTRIBUTING THE SOFTWARE BE LIABLE
// FOR ANY DAMAGES OR OTHER LIABILITY, WHETHER IN CONTRACT, TORT OR OTHERWISE,
// ARISING FROM, OUT OF OR IN CONNECTION WITH THE SOFTWARE OR THE USE OR OTHER
// DEALINGS IN THE SOFTWARE.
// 

#include <cstdio>
#include <cstdarg>

#include "cmsis_os.h"
#include "STM32Debug.h"
#include "main.h"

extern UART_HandleTypeDef huart3;
static osThreadId PRINTFThreadHandle;
static EPRI::STM32Base * g_pBL;
uint8_t EPRI::STM32Debug::instantiations = 0U;	// static member

static struct {
	struct {
		char * ptr = nullptr;
		int len = 0;
	} queue[UINT8_MAX + 1];
	uint8_t head = 0U;
	uint8_t tail = 0U;
} TxQueue;

extern "C"
{
	int _write(int file, char *ptr, int len)	// for printf
	{
		HAL_GPIO_TogglePin(LD2_GPIO_Port, LD2_Pin);
		TxQueue.queue[TxQueue.head].len = len;
		TxQueue.queue[TxQueue.head].ptr = (char *)realloc(TxQueue.queue[TxQueue.head].ptr, len);
		if(TxQueue.queue[TxQueue.head].ptr == NULL)
			TxQueue.queue[TxQueue.head].ptr = (char *)malloc(len);
		for(int i=0; i<len; i++)
			TxQueue.queue[TxQueue.head].ptr[i] = ptr[i];

		TxQueue.head++;
		return len;
	}

	static void PRINTFThread_fun(void const * argument)
	{
	  for(;;)
	  {
		  if(TxQueue.tail != TxQueue.head)
		  {
			  HAL_UART_Transmit(&huart3, (uint8_t *)TxQueue.queue[TxQueue.tail].ptr, TxQueue.queue[TxQueue.tail].len, 1000);
			  TxQueue.tail++;
		  }
		  else
		  {
			  HAL_GPIO_TogglePin(LD3_GPIO_Port, LD3_Pin);
			  osDelay(1000);
		  }
	  }
	}
}

namespace EPRI
{
	STM32Base::STM32Base()
	{
		HAL_GPIO_WritePin(LD2_GPIO_Port, LD2_Pin, GPIO_PIN_SET);
		g_pBL = this;
	}

	STM32Base::~STM32Base()
	{
	}

	STM32Debug * STM32Base::GetDebug()
	{
		return &m_Debug;
	}

	STM32Base * Base()
	{
		return g_pBL;
	}

    STM32Debug::STM32Debug()
    {
    	if(0U == instantiations++)
    	{
#ifdef __GNUC__
#pragma GCC diagnostic push
#pragma GCC diagnostic ignored "-Wwrite-strings"
#endif
    		osThreadDef(PRINTFThread, PRINTFThread_fun, osPriorityLow, 0, 128);
#ifdef __GNUC__
#pragma GCC diagnostic pop
#endif
    		PRINTFThreadHandle = osThreadCreate(osThread(PRINTFThread), NULL);
    	}
    }
    
    STM32Debug::~STM32Debug()
    {
    	if(--instantiations == 0U)
    		osThreadTerminate(PRINTFThreadHandle);
    }
    
    void STM32Debug::TRACE(const char * Format, ...)
    {
        va_list Args;
        va_start(Args, Format);
//#ifdef DEBUG
         vprintf(Format, Args);
//#endif
        va_end(Args);
    }
    
    void STM32Debug::TRACE_BUFFER(const char * Marker, const uint8_t * Buffer, size_t BufferSize, uint8_t BytesPerLine /*= 16*/)
    {
		TRACE("\r\n%s: ", Marker);
		const uint8_t * p = Buffer;
		while (p != (Buffer + BufferSize))
		{
			TRACE("%02X ", uint16_t(*p++));
			if (0 == (size_t(p - Buffer) % BytesPerLine))
			{
				TRACE("\r\n%s: ", Marker);
			}
		}
		TRACE("\r\n");
	}
    
    void STM32Debug::TRACE_VECTOR(const char * Marker, const WiFiBuffer& Data, uint8_t BytesPerLine /*= 16*/)
    {
        TRACE_BUFFER(Marker, Data.GetData(), Data.Size(), BytesPerLine);
    }
    
}
